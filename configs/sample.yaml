## configs/sample.yaml
```yaml
project:
  study_start_date: "2023-10-01"
  filter_end_date: "2023-12-31"
  archive_start_date: "2024-01-01"
  end_date: "2024-01-01"
  intervention_start_date: "2025-01-01"
  timezone: "Europe/Sofia"

sources:
  sofia_boundary_url: "https://api.sofiaplan.bg/datasets/79"
  sensor_community_archive: "https://archive.sensor.community"
  sensor_type: "sds011"
  era5_dataset: "reanalysis-era5-single-levels"

paths:
  sensor_locations: "sample_data/Sensor_Location.csv"
  bgr_directory: "sample_data/bgr"
  boundary: "sample_data/sofia_boundary.geojson"
  manifest: "data/interim/sample_manifest.csv"
  archive: "sample_data/archive"
  filter_hourly: "data/interim/sample_filter_hourly.csv"
  archive_hourly: "data/interim/sample_archive_hourly.csv"
  hourly: "data/interim/sample_hourly.csv"
  completeness_year: "data/processed/sample_year.csv"
  completeness_season: "data/processed/sample_season.csv"
  panel: "data/processed/sample_panel.csv"
  daily: "data/processed/sample_daily.csv"
  meteorology: "data/raw/meteorology/sample_era5"
  meteorology_ledger: "data/raw/meteorology/sample_era5/download_ledger.jsonl"
  background: "data/raw/background"
  policy: "data/raw/policy"
  predictors: "data/interim/predictors/sample_predictors.csv"
  model_config: "configs/model.yaml"
  model_table: "data/processed/sample_model_table.csv"
  validation_predictions: "data/interim/model/sample_rf_validation_predictions.csv"
  test_predictions: "data/interim/model/sample_rf_test_predictions.csv"
  tuning_results: "data/interim/model/sample_rf_tuning_results.csv"
  selected_parameters: "data/interim/model/sample_rf_selected_parameters.json"
  validation_metrics: "outputs/tables/sample_rf_validation_metrics.csv"
  validation_metrics_by_sensor: "outputs/tables/sample_rf_validation_metrics_by_sensor.csv"
  validation_metrics_by_season_part: "outputs/tables/sample_rf_validation_metrics_by_season_part.csv"
  validation_metrics_by_month: "outputs/tables/sample_rf_validation_metrics_by_month.csv"
  test_metrics: "outputs/tables/sample_rf_test_metrics.csv"
  test_metrics_by_sensor: "outputs/tables/sample_rf_test_metrics_by_sensor.csv"
  test_metrics_by_month: "outputs/tables/sample_rf_test_metrics_by_month.csv"
  predictor_shift: "outputs/tables/sample_rf_predictor_shift.csv"
  gradient_boosting_tuning_results: "data/interim/model/sample_gradient_boosting_tuning_results.csv"
  model_file: "models/sample_random_forest.joblib"
  model_metadata: "models/sample_random_forest_metadata.json"
  feature_importance: "outputs/tables/sample_rf_feature_importance.csv"
  predictions: "data/processed/sample_counterfactual_predictions.csv"
  counterfactual_summary: "outputs/tables/sample_counterfactual_summary.csv"
  counterfactual_by_date: "outputs/tables/sample_counterfactual_by_date.csv"
  counterfactual_by_sensor: "outputs/tables/sample_counterfactual_by_sensor.csv"
  figures: "outputs/figures"
  tables: "outputs/tables"

manifest:
  continuing_after: "2023-10-01"
  historical_qc_prefix: "1233"
  require_spread: 3

download:
  workers: 2
  retries: 0
  timeout_seconds: 5

meteorology:
  raw_file_pattern: "era5_single_levels_{year}_{month}.nc"
  date_padding_days: 1
  bbox_padding_degrees: 0.25
  status_interval_seconds: 30
  grid_assignment: "nearest"
  variables:
    - "2m_temperature"
    - "2m_dewpoint_temperature"
    - "10m_u_component_of_wind"
    - "10m_v_component_of_wind"
    - "surface_pressure"
    - "total_precipitation"
    - "boundary_layer_height"

qc:
  pm25_min: 0.0
  pm25_max: 1000.0
  minimum_twenty_minute_bins: 3
  temporal_window_hours: 24
  temporal_min_periods: 3
  temporal_mad_multiplier: 8.0
  temporal_absolute_floor: 75.0

aggregation:
  minimum_valid_hours_per_day: 1
  maximum_daily_pm25_exclusive: 250.0

panel_selection:
  minimum_day_fraction: 0.01
  pre_start_year: 2024
  pre_end_year: 2024
  post_periods:
    sample_period: ["2024-01-01", "2024-01-01"]
```
